## dts/bindings/sensor/st,lsm6ds3-i2c.yaml
```yaml
# Copyright (c) 2017, Linaro Limited
# Copyright (c) 2021, Łukasz Iwaszkiewicz
# SPDX-License-Identifier: Apache-2.0

description: STMicroelectronics LSM6DS3 6-axis accelerometer and gyrometer

compatible: "st,lsm6ds3"

include: i2c-device.yaml

properties:
    irq-gpios:
      # This signal is active high when produced by the sensor
      type: phandle-array
      required: false
```

## dts/bindings/sensor/st,lsm6ds3-spi.yaml
```yaml
# Copyright (c) 2018, Linaro Limited
# Copyright (c) 2021, Łukasz Iwaszkiewicz
# SPDX-License-Identifier: Apache-2.0

description: |
    STMicroelectronics LSM6DS3 6-axis accelerometer and gyrometer accessed
    through SPI bus

compatible: "st,lsm6ds3"

include: spi-device.yaml

properties:
    irq-gpios:
      # This signal is active high when produced by the sensor
      type: phandle-array
      required: false
```
